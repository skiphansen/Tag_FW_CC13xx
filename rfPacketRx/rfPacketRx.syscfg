/**
 * @cliArgs --board "/ti/boards/LP_CC1311R3" --device "CC1311R3RKP" --part "Default" --package "RKP" --rtos "nortos" --product "simplelink_cc13xx_cc26xx_sdk@8.30.01.01"
 * @versions {"tool":"1.21.1+3772"}
 */

/**
 * Import the modules used in this configuration.
 */
const CCFG     = scripting.addModule("/ti/devices/CCFG");
const custom   = scripting.addModule("/ti/devices/radioconfig/custom");
const rfdesign = scripting.addModule("/ti/devices/radioconfig/rfdesign");
const GPIO     = scripting.addModule("/ti/drivers/GPIO");
const RF       = scripting.addModule("/ti/drivers/RF");

/**
 * Write custom configuration values to the imported modules.
 */
CCFG.xoscCapArray            = true;
CCFG.xoscCapArrayDelta       = 0xC1;
CCFG.enableBootloader        = true;
CCFG.dioBootloaderBackdoor   = 15;
CCFG.levelBootloaderBackdoor = "Active low";
CCFG.ccfgTemplate.$name      = "ti_devices_CCFG_CCFGCC26XXTemplate0";

custom.prop8                                                      = ["custom868"];
custom.radioConfigcustom868.phyType868                            = "2gfsk50kbps";
custom.radioConfigcustom868.$name                                 = "RF_Custom_Setting";
custom.radioConfigcustom868.txPower                               = "10";
custom.radioConfigcustom868.symbolRate                            = 250.000;
custom.radioConfigcustom868.rxFilterBw                            = "621.6";
custom.radioConfigcustom868.whitening                             = "CC1101/CC2500 compatible";
custom.radioConfigcustom868.syncWord                              = 0xD391D391;
custom.radioConfigcustom868.deviation                             = 165.0;
custom.radioConfigcustom868.codeExportConfig.$name                = "ti_devices_radioconfig_code_export_param0";
custom.radioConfigcustom868.codeExportConfig.paExport             = "none";
custom.radioConfigcustom868.codeExportConfig.txPower              = "txPowerTable_2gfsk50kbps_0";
custom.radioConfigcustom868.codeExportConfig.txPowerSize          = "TX_POWER_TABLE_SIZE_2gfsk50kbps_0";
custom.radioConfigcustom868.codeExportConfig.rfMode               = "RF_prop_2gfsk50kbps_0";
custom.radioConfigcustom868.codeExportConfig.overrides            = "pOverrides_2gfsk50kbps_0";
custom.radioConfigcustom868.codeExportConfig.cmdPropRadioDivSetup = "RF_cmdPropRadioDivSetup_2gfsk50kbps_0";
custom.radioConfigcustom868.codeExportConfig.cmdFs                = "RF_cmdFs_2gfsk50kbps_0";
custom.radioConfigcustom868.codeExportConfig.cmdTxTest            = "RF_cmdTxTest_2gfsk50kbps_0";
custom.radioConfigcustom868.codeExportConfig.cmdRxTest            = "RF_cmdRxTest_2gfsk50kbps_0";
custom.radioConfigcustom868.codeExportConfig.cmdPropTx            = "RF_cmdPropTx_2gfsk50kbps_0";
custom.radioConfigcustom868.codeExportConfig.cmdPropRx            = "RF_cmdPropRx_2gfsk50kbps_0";
custom.radioConfigcustom868.codeExportConfig.cmdNop               = "RF_cmdNop_2gfsk50kbps_0";
custom.radioConfigcustom868.codeExportConfig.cmdRadioSetup        = "RF_cmdRadioSetup_2gfsk50kbps_0";
custom.radioConfigcustom868.codeExportConfig.cmdFsOff             = "RF_cmdFsOff_2gfsk50kbps_0";
custom.radioConfigcustom868.codeExportConfig.cmdSyncStopRat       = "RF_cmdSyncStopRat_2gfsk50kbps_0";
custom.radioConfigcustom868.codeExportConfig.cmdSyncStartRat      = "RF_cmdSyncStartRat_2gfsk50kbps_0";
custom.radioConfigcustom868.codeExportConfig.cmdResyncRat         = "RF_cmdResyncRat_2gfsk50kbps_0";
custom.radioConfigcustom868.codeExportConfig.cmdCount             = "RF_cmdCount_2gfsk50kbps_0";
custom.radioConfigcustom868.codeExportConfig.cmdFsPowerup         = "RF_cmdFsPowerup_2gfsk50kbps_0";
custom.radioConfigcustom868.codeExportConfig.cmdFsPowerdown       = "RF_cmdFsPowerdown_2gfsk50kbps_0";
custom.radioConfigcustom868.codeExportConfig.cmdSchImm            = "RF_cmdSchImm_2gfsk50kbps_0";
custom.radioConfigcustom868.codeExportConfig.cmdCountBranch       = "RF_cmdCountBranch_2gfsk50kbps_0";
custom.radioConfigcustom868.codeExportConfig.cmdPatternCheck      = "RF_cmdPatternCheck_2gfsk50kbps_0";
custom.radioConfigcustom868.codeExportConfig.cmdPropTxAdv         = "RF_cmdPropTxAdv_2gfsk50kbps_0";
custom.radioConfigcustom868.codeExportConfig.cmdPropRxAdv         = "RF_cmdPropRxAdv_2gfsk50kbps_0";
custom.radioConfigcustom868.codeExportConfig.cmdPropCs            = "RF_cmdPropCs_2gfsk50kbps_0";
custom.radioConfigcustom868.codeExportConfig.cmdPropRadioSetup    = "RF_cmdPropRadioSetup_2gfsk50kbps_0";
custom.radioConfigcustom868.codeExportConfig.cmdPropRxSniff       = "RF_cmdPropRxSniff_2gfsk50kbps_0";
custom.radioConfigcustom868.codeExportConfig.cmdPropRxAdvSniff    = "RF_cmdPropRxAdvSniff_2gfsk50kbps_0";
